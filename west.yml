## west.yml
```yaml
# Copyright (c) 2025 STMicroelectronics
# SPDX-License-Identifier: Apache-2.0

manifest:
  version: 1.0

  self:
    path: zephyr-stm32n6-ai-people-detection
    west-commands: app/scripts/west-commands.yml

  projects:
    - name: zephyr
      url: https://github.com/zephyrproject-rtos/zephyr.git
      revision: v4.5.0
      west-commands: scripts/west-commands.yml
      import:
        name-allowlist:
          - cmsis_6
          - cmsis-dsp
          - hal_stm32
          - lvgl
          - mcuboot
          - mbedtls
          - tf-psa-crypto

    - name: zephyr-stm32-mw-isp
      url: https://github.com/stm32-hotspot/zephyr-stm32-mw-isp.git
      revision: v0.4.0
      path: st/lib/zephyr-stm32-mw-isp
      submodules: true
```
