## CMakeLists.txt
```
##############################################################################
# @file    CMakeLists.txt
# @author  GPM Application Team
#
##############################################################################
# @attention
#
# Copyright (c) 2025 STMicroelectronics.
# All rights reserved.
#
# This software is licensed under terms that can be found in the LICENSE file
# in the root directory of this software component.
# If no LICENSE file comes with this software, it is provided AS-IS.
#
##############################################################################

cmake_minimum_required(VERSION 3.20.0)

set(BOARD stm32n6570_dk)
set(SHIELD st_b_cams_imx_mb1854)

find_package(Zephyr REQUIRED HINTS $ENV{ZEPHYR_BASE})

project(app LANGUAGES C)

target_include_directories(app PRIVATE inc Model)
target_sources(app PRIVATE src/main.c src/model.c Model/network.c Model/stai_network.c src/zephyr_logo.c)

# lib_vision_models_pp
target_include_directories(app PRIVATE ../Lib/lib_vision_models_pp/lib_vision_models_pp/Inc
                           ../Lib/lib_vision_models_pp/Drivers/CMSIS/DSP/Include)

target_sources(app PRIVATE ../Lib/lib_vision_models_pp/lib_vision_models_pp/Src/vision_models_pp.c
                           ../Lib/lib_vision_models_pp/lib_vision_models_pp/Src/vision_models_pp_maxi_if32.c
                           ../Lib/lib_vision_models_pp/lib_vision_models_pp/Src/vision_models_pp_maxi_is8.c
                           ../Lib/lib_vision_models_pp/lib_vision_models_pp/Src/vision_models_pp_maxi_iu8.c
                           ../Lib/lib_vision_models_pp/lib_vision_models_pp/Src/od_pp_yolov2.c
                           ../Lib/lib_vision_models_pp/lib_vision_models_pp/Src/od_pp_yolov5.c
                           ../Lib/lib_vision_models_pp/lib_vision_models_pp/Src/od_pp_yolov8.c
                           ../Lib/lib_vision_models_pp/lib_vision_models_pp/Src/od_pp_st_yolox.c)

# AI_Runtime
target_compile_definitions(app PRIVATE LL_ATON_PLATFORM=LL_ATON_PLAT_STM32N6
                           LL_ATON_OSAL=LL_ATON_OSAL_ZEPHYR
                           LL_ATON_RT_MODE=LL_ATON_RT_ASYNC
                           LL_ATON_SW_FALLBACK
                           LL_ATON_DBG_BUFFER_INFO_EXCLUDED=1
                           APP_HAS_PARALLEL_NETWORKS=0)

target_include_directories(app PRIVATE ../Lib/AI_Runtime/Inc
                           ../Lib/AI_Runtime/Npu/ll_aton
                           ../Lib/AI_Runtime/Npu/Devices/STM32N6xx)

target_sources(app PRIVATE ../Lib/AI_Runtime/Npu/ll_aton/ll_aton.c
               ../Lib/AI_Runtime/Npu/ll_aton/ll_aton_osal_zephyr.c
               ../Lib/AI_Runtime/Npu/ll_aton/ll_aton_debug.c
               ../Lib/AI_Runtime/Npu/ll_aton/ll_aton_lib.c
               ../Lib/AI_Runtime/Npu/ll_aton/ll_aton_lib_sw_operators.c
               ../Lib/AI_Runtime/Npu/ll_aton/ll_aton_rt_main.c
               ../Lib/AI_Runtime/Npu/ll_aton/ll_aton_runtime.c
               ../Lib/AI_Runtime/Npu/ll_aton/ll_aton_cipher.c
               ../Lib/AI_Runtime/Npu/ll_aton/ll_aton_stai_internal.c
               ../Lib/AI_Runtime/Npu/ll_aton/ll_aton_util.c
               ../Lib/AI_Runtime/Npu/ll_aton/ll_sw_float.c
               ../Lib/AI_Runtime/Npu/ll_aton/ll_sw_integer.c
               ../Lib/AI_Runtime/Npu/ll_aton/ecloader.c
               ../Lib/AI_Runtime/Npu/Devices/STM32N6xx/npu_cache.c
               ../Lib/AI_Runtime/Npu/Devices/STM32N6xx/mcu_cache.c)

target_link_directories(app PUBLIC ../Lib/AI_Runtime/Lib/GCC/ARMCortexM55)

target_link_libraries(app PRIVATE :NetworkRuntime1210_CM55_GCC.a)
```

## prj.conf
```kconfig
# Copyright (c) 2025 STMicroelectronics
# All rights reserved.
#
# This software is licensed under terms that can be found in the LICENSE file
# in the root directory of this software component.
# If no LICENSE file comes with this software, it is provided AS-IS.

CONFIG_MY_APP=y
CONFIG_MAIN_STACK_SIZE=8192
# CONFIG_XIP is not set
CONFIG_USE_STM32_MW_ISP=y
CONFIG_DYNAMIC_INTERRUPTS=y
CONFIG_FLASH=y
CONFIG_HW_STACK_PROTECTION=y
CONFIG_GPIO=y
CONFIG_SERIAL=y
CONFIG_LOG=y
CONFIG_ASSERT=y
CONFIG_CONSOLE=y
CONFIG_LV_USE_CANVAS=y
CONFIG_LV_USE_THEME_DEFAULT=y
CONFIG_LVGL=y
CONFIG_LV_Z_MEM_POOL_SIZE=12288
CONFIG_ARM_MPU=y
# CONFIG_THREAD_MONITOR is not set
# CONFIG_THREAD_NAME is not set
CONFIG_UART_CONSOLE=y
CONFIG_DISPLAY=y
CONFIG_FLASH_STM32_NOR_MEMMAP=y
CONFIG_VIDEO=y
CONFIG_VIDEO_BUFFER_POOL_NUM_MAX=4
CONFIG_VIDEO_BUFFER_POOL_HEAP_SIZE=2575000
CONFIG_VIDEO_STM32_DCMIPP_SENSOR_WIDTH=2592
CONFIG_VIDEO_STM32_DCMIPP_SENSOR_HEIGHT=1944
CONFIG_VIDEO_STM32_DCMIPP_SENSOR_PIXEL_FORMAT="pRAA"
CONFIG_CPU_LOAD=y
# To be sure LOGGER can still ouput message move this one priority level above main thread
CONFIG_LOG_PROCESS_THREAD_CUSTOM_PRIORITY=y
CONFIG_LOG_PROCESS_THREAD_PRIORITY=13
CONFIG_LV_FONT_UNSCII_16=y
```

## src/main.c
```c
/**
 ******************************************************************************
 * @file    main.c
 * @author  GPM Application Team
 *
 ******************************************************************************
 * @attention
 *
 * Copyright (c) 2025 STMicroelectronics.
 * All rights reserved.
 *
 * This software is licensed under terms that can be found in the LICENSE file
 * in the root directory of this software component.
 * If no LICENSE file comes with this software, it is provided AS-IS.
 *
 ******************************************************************************
 */

#include <zephyr/kernel.h>
#include <zephyr/drivers/video.h>
#include <zephyr/drivers/display.h>
#include <zephyr/sys/__assert.h>
#include <zephyr/sys/cpu_load.h>
#include <zephyr/logging/log.h>
#include <zephyr/sys/util.h>

#include <lvgl.h>

#include <stdarg.h>

#include "model.h"
#include "stai_network.h"

LOG_MODULE_REGISTER(main);

#define DISPLAY_WIDTH DT_PROP(DT_CHOSEN(zephyr_display), width)
#define DISPLAY_HEIGHT DT_PROP(DT_CHOSEN(zephyr_display), height)

#define NN_WIDTH STAI_NETWORK_IN_1_WIDTH
#define NN_HEIGHT STAI_NETWORK_IN_1_HEIGHT
#define NPU_BUFFER_POOL_ALIGN 32

/* Tune ui layout */
#define APP_DRAW_INF_TIME 0
#define APP_DRAW_INF_FPS 1
#define APP_DRAW_CPU_LOAD 0
#define APP_DRAW_LOGO 1

LV_IMAGE_DECLARE(zephyr_logo);

static struct k_thread nn_thread;
static K_THREAD_STACK_DEFINE(nn_thread_stack, 4096);

static int display_setup(const struct device *const display_dev)
{
	int ret;

	ret = display_set_pixel_format(display_dev, PIXEL_FORMAT_RGB_565);
	__ASSERT_NO_MSG(ret == 0);

	ret = display_blanking_off(display_dev);
	__ASSERT_NO_MSG(ret == 0);

	return 0;
}

static void print_text(lv_layer_t *layer, int x, int y, lv_text_align_t align, char *fmt, ...)
{
	lv_draw_label_dsc_t tdsc;
	char text_buffer[128];
	lv_area_t coords;
	va_list ap;

	va_start(ap, fmt);
	vsnprintf(text_buffer, sizeof(text_buffer), fmt, ap);

	/* shadow */
	lv_draw_label_dsc_init(&tdsc);
	tdsc.color = lv_color_make(16, 16, 16);
	tdsc.font = &lv_font_unscii_16;
	coords.x1 = x + 1;
	coords.y1 = y + 1;
	coords.x2 = DISPLAY_WIDTH;
	coords.y2 = DISPLAY_HEIGHT;
	tdsc.text = text_buffer;
	tdsc.text_local = 1;
	tdsc.align = align;
	lv_draw_label(layer, &tdsc, &coords);

	/* text */
	tdsc.color = lv_color_make(255, 255, 255);
	coords.x1 = x;
	coords.y1 = y;
	lv_draw_label(layer, &tdsc, &coords);
	va_end(ap);
}

static void decorate_canvas(lv_obj_t * canvas)
{
	int latest_inference_time = model_get_latest_inference_time();
	const lv_font_t *font = &lv_font_unscii_16;
	lv_draw_image_dsc_t idsc;
	lv_draw_rect_dsc_t rdsc;
	struct dbox boxes[10];
	lv_area_t coords;
	lv_layer_t layer;
	struct dbox *b;
	uint32_t ver;
	int load;
	int nb;
	int i;

	ver = sys_kernel_version_get();
	nb = model_get_boxes(boxes, ARRAY_SIZE(boxes));

	lv_canvas_init_layer(canvas, &layer);
	/* Draw banner */
	print_text(&layer, 0, 0, LV_TEXT_ALIGN_CENTER, "YoloX People Detection");
	print_text(&layer, 0, font->line_height, LV_TEXT_ALIGN_CENTER, "Powered by zephyr OS %d.%d.%d",
		   SYS_KERNEL_VER_MAJOR(ver), SYS_KERNEL_VER_MINOR(ver), SYS_KERNEL_VER_PATCHLEVEL(ver));

	/* Draw inference time */
	if (APP_DRAW_INF_TIME) {
		print_text(&layer, 0, DISPLAY_HEIGHT - font->line_height * 3, LV_TEXT_ALIGN_LEFT, "Inference %d ms",
			   latest_inference_time);
	}
	/* Draw inference fps */
	if (APP_DRAW_INF_FPS) {
		latest_inference_time = latest_inference_time ? latest_inference_time : 1;
		print_text(&layer, 0, DISPLAY_HEIGHT - font->line_height * 2, LV_TEXT_ALIGN_LEFT, "Fps       %d",
			   1000 / latest_inference_time);
	}
	/* Draw cpu load */
#ifdef CONFIG_CPU_LOAD
	if (APP_DRAW_CPU_LOAD) {
		load = cpu_load_get(1);
		print_text(&layer, 0, DISPLAY_HEIGHT - font->line_height * 1, LV_TEXT_ALIGN_LEFT, "cpu load  %d.%d%%",
			   load / 10, load % 10);
	}
#else
	(void)load;
#endif

	/* Draw logo */
	if (APP_DRAW_LOGO) {
		lv_draw_image_dsc_init(&idsc);
		idsc.src = &zephyr_logo;
		coords.x1 = DISPLAY_WIDTH - zephyr_logo.header.w - 10;
		coords.y1 = DISPLAY_HEIGHT - zephyr_logo.header.h - 10;
		coords.x2 = coords.x1 + zephyr_logo.header.w - 1;
		coords.y2 = coords.y1 + zephyr_logo.header.h - 1;
		lv_draw_image(&layer, &idsc, &coords);
	}

	/* Draw boxes */
	lv_draw_rect_dsc_init(&rdsc);
	rdsc.border_color = lv_palette_main(LV_PALETTE_GREEN);
	rdsc.border_width = 2;
	rdsc.radius = 10;
	rdsc.bg_opa = 0;
	for (i = 0; i < nb; i++) {
		b = &boxes[i];
		coords.x1 = b->x;
		coords.y1 = b->y;
		coords.x2 = b->x + b->w;
		coords.y2 = b->y + b->h;
		lv_draw_rect(&layer, &rdsc, &coords);
	}

	lv_canvas_finish_layer(canvas, &layer);
}

static int video_crop_setup(const struct device *const video_dev, uint32_t sensor_width, uint32_t sensor_height)
{
	const float ratioy = (float)sensor_height / DISPLAY_HEIGHT;
	const float ratiox = (float)sensor_width / DISPLAY_WIDTH;
	const float ratio = MIN(ratiox, ratioy);
	struct video_selection crop = {
		.type = VIDEO_BUF_TYPE_OUTPUT,
	};
	int ret;

	__ASSERT_NO_MSG(ratio >= 1);
	__ASSERT_NO_MSG(ratio < 64);

	crop.target = VIDEO_SEL_TGT_CROP;
	crop.rect.width = DISPLAY_WIDTH * ratio;
	crop.rect.height = DISPLAY_HEIGHT * ratio;
	crop.rect.left = (sensor_width - crop.rect.width + 1) /2;
	crop.rect.top = (sensor_height - crop.rect.height + 1) / 2;

	ret = video_set_selection(video_dev, &crop);
	__ASSERT_NO_MSG(ret == 0);

	return 0;
}

static int video_resize_setup(const struct device *const video_dev, uint32_t width, uint32_t height)
{
	struct video_selection comp = {
		.type = VIDEO_BUF_TYPE_OUTPUT,
	};
	int ret;

	comp.target = VIDEO_SEL_TGT_COMPOSE;
	comp.rect.left = 0;
	comp.rect.top = 0;
	comp.rect.width = width;
	comp.rect.height = height;

	ret = video_set_selection(video_dev, &comp);
	__ASSERT_NO_MSG(ret == 0);

	return 0;
}

static int video_alloc_and_queue_buffers(const struct device *const video_dev, size_t bsize, int align)
{
	struct video_buffer *buffers[2];
	int ret;
	int i;

	for (i = 0; i < ARRAY_SIZE(buffers); i++) {
		buffers[i] = video_buffer_aligned_alloc(bsize, align, K_FOREVER);
		__ASSERT_NO_MSG(buffers[i]);
		buffers[i]->type = VIDEO_BUF_TYPE_OUTPUT;
		ret = video_enqueue(video_dev, buffers[i]);
		__ASSERT_NO_MSG(ret == 0);
		LOG_INF("buffer %p(%p) queue to %s pipe", (void *)buffers[i], (void *)buffers[i]->buffer, video_dev->name);
	}

	return 0;
}

static int video_main_setup(const struct device *const video_dev, uint32_t sensor_width, uint32_t sensor_height)
{
	struct video_format fmt;
	int ret;

	/* setup crop, compose and output */
	ret = video_crop_setup(video_dev, sensor_width, sensor_height);
	__ASSERT_NO_MSG(ret == 0);
	ret = video_resize_setup(video_dev, DISPLAY_WIDTH, DISPLAY_HEIGHT);
	__ASSERT_NO_MSG(ret == 0);
	fmt.pixelformat = VIDEO_FOURCC_FROM_STR("RGBP");
	fmt.width = DISPLAY_WIDTH;
	fmt.height = DISPLAY_HEIGHT;
	ret = video_set_format(video_dev, &fmt);
	__ASSERT_NO_MSG(ret == 0);

	/* alloc buffers and queue them */
	ret = video_alloc_and_queue_buffers(video_dev, fmt.size, CONFIG_VIDEO_BUFFER_POOL_ALIGN);
	__ASSERT_NO_MSG(ret == 0);

	return 0;
}

static int video_aux_setup(const struct device *const video_dev, uint32_t sensor_width, uint32_t sensor_height)
{
	struct video_format fmt;
	int ret;

	/* setup crop, compose and output */
	ret = video_crop_setup(video_dev, sensor_width, sensor_height);
	__ASSERT_NO_MSG(ret == 0);
	ret = video_resize_setup(video_dev, NN_WIDTH, NN_HEIGHT);
	__ASSERT_NO_MSG(ret == 0);
	fmt.pixelformat = VIDEO_FOURCC_FROM_STR("RGB3");
	fmt.width = NN_WIDTH;
	fmt.height = NN_HEIGHT;
	ret = video_set_format(video_dev, &fmt);
	__ASSERT_NO_MSG(ret == 0);

	/* alloc buffers and queue them */
	ret = video_alloc_and_queue_buffers(video_dev, fmt.size, NPU_BUFFER_POOL_ALIGN);
	__ASSERT_NO_MSG(ret == 0);

	return 0;
}

static int video_setup(const struct device *const main_dev, const struct device *const aux_dev)
{
	struct video_format fmt;
	uint32_t sensor_height;
	uint32_t sensor_width;
	int ret;

	/* get default format to get sensor width / height */
	ret = video_get_format(main_dev, &fmt);
	__ASSERT_NO_MSG(ret == 0);
	sensor_height = fmt.height;
	sensor_width = fmt.width;

	ret = video_main_setup(main_dev, sensor_width, sensor_height);
	__ASSERT_NO_MSG(ret == 0);

	ret = video_aux_setup(aux_dev, sensor_width, sensor_height);
	__ASSERT_NO_MSG(ret == 0);

	return 0;
}

int main()
{
	const struct device *const camera_aux_dev = DEVICE_DT_GET(DT_CHOSEN(zephyr_camera_aux));
	const struct device *const display_dev = DEVICE_DT_GET(DT_CHOSEN(zephyr_display));
	const struct device *const video_dev = DEVICE_DT_GET(DT_CHOSEN(zephyr_camera));
	struct video_buffer *vbuf;
	lv_obj_t *canvas;
	k_tid_t nn_tid;
	int ret;

	__ASSERT_NO_MSG(device_is_ready(video_dev));
	__ASSERT_NO_MSG(device_is_ready(camera_aux_dev));
	__ASSERT_NO_MSG(device_is_ready(display_dev));

	/* move main thread priority to lowest one so we let others thread a chance to run */
	k_thread_priority_set(k_current_get(), K_LOWEST_APPLICATION_THREAD_PRIO);

	/* create thread for nn process */
	nn_tid = k_thread_create(&nn_thread, nn_thread_stack, K_THREAD_STACK_SIZEOF(nn_thread_stack), model_thread_ep,
				 (void *) camera_aux_dev, NULL, NULL, 0, 0, K_NO_WAIT);
	__ASSERT_NO_MSG(nn_tid);

	/* Configure display */
	ret = display_setup(display_dev);
	__ASSERT_NO_MSG(ret == 0);

	/* Configure video pipe */
	ret = video_setup(video_dev, camera_aux_dev);
	__ASSERT_NO_MSG(ret == 0);

	/* Start main pipe */
	LOG_INF("Starting main pipe");
	ret = video_stream_start(video_dev, VIDEO_BUF_TYPE_OUTPUT);
	__ASSERT_NO_MSG(ret == 0);

	LOG_INF("Starting aux pipe");
	ret = video_stream_start(camera_aux_dev, VIDEO_BUF_TYPE_OUTPUT);
	__ASSERT_NO_MSG(ret == 0);

	LOG_INF("STARTING");

	canvas = lv_canvas_create(lv_scr_act());
	while (1) {
		ret = video_dequeue(video_dev, &vbuf, K_FOREVER);
		__ASSERT_NO_MSG(ret == 0);

		lv_canvas_set_buffer(canvas, vbuf->buffer, DISPLAY_WIDTH, DISPLAY_HEIGHT, LV_COLOR_FORMAT_RGB565);
		decorate_canvas(canvas);
		lv_timer_handler();

		ret = video_enqueue(video_dev, vbuf);
		__ASSERT_NO_MSG(ret == 0);
	}

	return 0;
}
```
